/*                      - lnkm256rfa2.xcl -
 *
 *   XLINK command file for the ICCAVR C-compiler using the --cpu=m256rfa2, -ms
 *   options. Segments are defined for an ATmega256RFA2.
 *
 *   Usage: xlink your_file(s) -f lnkm256rfa2
 *
 *   File version: $Revision: 9419 $
 */

/*====================================================*/
/* 
 * Constants used down below, 
 * Do not change these lines, 
 * if it is not stated otherwise 
 */

/* Code (flash) segments */
-D_..X_INTVEC_SIZE=134  /* 4 bytes * 77 vectors */
-D_..X_FLASH_TEND=FF    /* End of tiny flash memory */
-D_..X_FLASH_NEND=FFFF  /* End of near flash memory */
-D_..X_FLASH_END=3FFFF  /* End of flash memory */
-D_..X_BOOT_START=3F000  /* Start of Boot sector memory 255 to 256 K*/

-D_..X_BOOT_END=3FFFF  // End of Boot memory 256K
/* PDS NV memory start address */
-D_PDS_NV_MEMORY_START=700
/* Boot flash section start address */
-D_BOOT_SECTION_START=3F000
/* No-Read-While-Write (NRWW) section start address */
-D_NRWW_SECTION_START=3E000

/* Internal data memory */

-D_..X_SRAM_BASE=200    /* Start of ram memory */
-D_..X_SRAM_TEND=100    /* End of tiny ram memory */

-D_..X_SRAM_END=81FF    /* End of ram memory */
/* Internal EEPROM */
-D_..X_EEPROM_END=1FFF  /* End of eeprom memory */
/*====================================================*/


/*
 * Modify the lines below to alter the size of the RSTACK, CSTACK and HEAP
 * segments. These need to be fine tuned to suit your specific application.
 * The '_..X_' prefix is used by C-SPY as an indication that the label should
 * not be displayed in the dissassembly window.
 */
/* -D_..X_CSTACK_SIZE=1000 */ /* 512 bytes for auto variables and saved registers. */
/*-D_..X_RSTACK_SIZE=800 */  /* 64 bytes for return addresses, equivalent to 32 */
                        /* levels of calls, including interrupts. */
/*-D_..X_HEAP_SIZE=100 */    /* 256 bytes of heap. */
/*-D_..X_NEAR_HEAP_SIZE=400 */  /* 1024 bytes of heap. */

/*
 * The following segments are located in the internal memory of
 * the ATmega256RFA2. Do not change these lines.
 */

/* Define CPU */
-ca90

/* Code memory */
-Z(CODE)INTVEC=0-(_..X_INTVEC_SIZE-1) 



/* -Z(CODE)TINY_F=_..X_INTVEC_SIZE-_..X_FLASH_TEND */
-Z(CODE)NEAR_F,SWITCH,DIFUNCT=_..X_INTVEC_SIZE-_..X_FLASH_NEND
-Z(CODE)PDS_NV_MEM=_PDS_NV_MEMORY_START-_..X_FLASH_NEND              /* PDS NV memory */
-Z(CODE)PDS_FF=_..X_INTVEC_SIZE-_..X_FLASH_NEND                      /* PDS files descriptors segment */
-Z(CODE)PDS_FD=_..X_INTVEC_SIZE-_..X_FLASH_NEND                      /* PDS directories descriptors segment */
-Z(CODE)BOOT_SECTION=_BOOT_SECTION_START-_..X_FLASH_END              /* Boot section definition */
-Z(CODE)NRWW_SECTION=_NRWW_SECTION_START-_..X_FLASH_END              /* No-Read-While-Write section definition */
-Z(CODE)CODE=_..X_INTVEC_SIZE-_..X_FLASH_END
-P(CODE)FAR_F=[_..X_INTVEC_SIZE-_..X_FLASH_END]/10000
-Z(CODE)HUGE_F,INITTAB=_..X_INTVEC_SIZE-_..X_FLASH_END
-Z(CODE)/*TINY_ID,*/NEAR_ID,FARCODE=_..X_INTVEC_SIZE-_..X_FLASH_END
-Z(CODE)CHECKSUM#_..X_FLASH_END
-Z(CODE)bootloader=_..X_BOOT_START-_..X_BOOT_END     
/* Internal data memory */
/*-Z(DATA)TINY_I,TINY_Z,TINY_N=_..X_SRAM_BASE-_..X_SRAM_TEND*/
-Z(DATA)NEAR_I,NEAR_Z,NEAR_N=_..X_SRAM_BASE-_..X_SRAM_END

/*
 * If external SRAM is available it is possible to place the stacks there.
 * However, the external memory is slower than the internal so moving the
 * stacks to the external memory will degrade the system performance.
 */
-Z(DATA)RSTACK+_..X_RSTACK_SIZE=_..X_SRAM_BASE-_..X_SRAM_END
-Z(DATA)CSTACK+_..X_CSTACK_SIZE=_..X_SRAM_BASE-_..X_SRAM_END

/*
 * If external SRAM is available it might be a good idea to move the
 * heap segment there, i.e. remove the _..X_SRAM_BASE-_..X_SRAM_END range.
 */
-Z(DATA)HEAP+_..X_HEAP_SIZE=_..X_SRAM_BASE-_..X_SRAM_END
-Z(DATA)IOSTREAM_N#_..X_SRAM_BASE-_..X_SRAM_END
-Z(DATA)NEAR_HEAP+_..X_NEAR_HEAP_SIZE=_..X_SRAM_BASE-_..X_SRAM_END

/* Internal eeprom memory */
-Z(XDATA)EEPROM_I,EEPROM_N=0-_..X_EEPROM_END

// The compiler and linker now automatically includes the smallest set of
// run-time library string formatting support possible for functions such as
// printf/scanf, based on which formatters that are actually used in the
// application. To revert to the old behavior of specifying the level of
// support manually, the default linker files needs to be modified. Please
// see comments inside the linker files for more information on which
// modifications that are needed.
// 
// /* Select reduced "printf" support to reduce library size.
//    See configuration section in manual concerning printf/sprintf. */
// 
// /*Dlib*/
// -e_PrintfSmall=_Printf
// 
// /*Clib*/
// -e_small_write=_formatted_write
// 
// /*Dlib and Clib*/
// -e_small_write_P=_formatted_write_P
// 
// /* Disable floating-point support in "scanf" to reduce library size.
//    See configuration section in manual concerning scanf/sscanf */
// 
// /*Dlib*/
// -e_ScanfSmall=_Scanf
// 
// /*Clib*/
// -e_medium_read=_formatted_read
// 
// /*Dlib and Clib*/
// -e_medium_read_P=_formatted_read_P

/* Suppress one warning which is not relevant for this processor */
-w29

/* Code will now reside in file aout.a90 or aout.d90, unless -o is specified */
/* .d90 is the default if debug system is linked (option -r) */
/* .a90 is the default without debugging. Default format is -Fmotorola */
